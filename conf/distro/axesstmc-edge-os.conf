## conf/distro/axesstmc-edge-os.conf
```bitbake
DISTRO = "axesstmc-edge-os"
DISTRO_NAME = "AxessTMC Edge OS"
DISTRO_VERSION = "1.0.0"

EXTRA_IMAGE_FEATURES += "ssh-server-dropbear"
```

## conf/layer.conf
```bitbake
# We have a conf and classes directory, add to BBPATH
BBPATH .= ":${LAYERDIR}"

# We have recipes-* directories, add to BBFILES
BBFILES += "${LAYERDIR}/recipes-*/*/*.bb \
	    ${LAYERDIR}/recipes-*/*/*.bbappend"

BBFILE_COLLECTIONS += "axs"
BBFILE_PATTERN_axs = "^${LAYERDIR}/"
BBFILE_PRIORITY_axs = "5"

LAYERSERIES_COMPAT_axs = "gatesgarth"

LAYERVERSION_axs = "2"
```
